## boards/arm/thingy53_nrf5340/dts/bindings/nordic-thingy53-npm1100-mode.yaml
```yaml
# Copyright (c) 2021 Nordic Semiconductor ASA
# SPDX-License-Identifier: Apache-2.0

description: GPIO used to set PWM mode on npm1100 GPIO on Thingy:53

compatible: "nordic,thingy53-npm1100-mode"

include: base.yaml

properties:
  status:
    required: true

  gpios:
    type: phandle-array
    required: true
    description: |
      GPIO to use as npm1100 mode line: output in nRF5340, input in npm11100.
```
